## sources/meta-ek/conf/layer.conf
```bitbake
# We have a conf and classes directory, add to BBPATH
BBPATH .= ":${LAYERDIR}"

# We have recipes-* directories, add to BBFILES
BBFILES += "${LAYERDIR}/recipes-*/*/*.bb \
            ${LAYERDIR}/recipes-*/*/*.bbappend"

BBFILE_COLLECTIONS += "meta-ek"
BBFILE_PATTERN_meta-ek = "^${LAYERDIR}/"
BBFILE_PRIORITY_meta-ek = "6"

LAYERDEPENDS_meta-ek = "core"
LAYERSERIES_COMPAT_meta-ek = "kirkstone"
```
